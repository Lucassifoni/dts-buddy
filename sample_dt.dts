
    iex> ~DTS"""
     /dts-v1/;
    /plugin/;

    /* Compile:
        dtc -@ -I dts -O dtb -o gpio_led.dtbo gpio_led.dts
    */

    &{/} {
        gpios_leds {
            compatible = "gpio-leds";
            test_led@36 {
                label = "test-led-gpio36";
                gpios = <&pio 1 4 0>; /* GPIO36/PB4 */

                /* Blink LED at 1 Hz (500 ms on, off) */
                linux,default-trigger = "pattern";
                led-pattern = <1 500 1 0 0 500 0 0>;
            };
        };
    };
    """test_led  
